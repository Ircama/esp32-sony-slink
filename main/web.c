/* Web portal: static page + WebSocket (/ws) carrying the CLI text protocol and JSON state frames.
 *   browser -> device : one CLI command per text frame
 *   device  -> browser: JSON frames ({"t":"state"|"presets"|"stations",...}) and plain CLI output lines */
#include <stdio.h>
#include <string.h>
#include <stdlib.h>
#include <unistd.h>
#include "esp_http_server.h"
#include "freertos/FreeRTOS.h"
#include "freertos/task.h"
#include "freertos/semphr.h"
#include "freertos/message_buffer.h"
#include "net.h"
#include "cli.h"
#include "state.h"

#include "web_page.h"                         /* the page, manifest, service worker and icons, generated by tools/gen_web.py */

#define MAX_WS 6
#define LINE_MAX_OUT 300

static httpd_handle_t s_srv;
static int s_fds[MAX_WS];
static SemaphoreHandle_t s_mtx;
static MessageBufferHandle_t s_mb;
static SemaphoreHandle_t s_wmtx;      /* a FreeRTOS message buffer allows ONE writer: serialise the writers */
static TaskHandle_t s_tx_task;
static volatile uint32_t s_dbg_q, s_dbg_drop, s_dbg_rx, s_dbg_sent, s_dbg_fail, s_dbg_adds, s_dbg_get;
static volatile int s_dbg_err;

bool web_running(void) { return s_srv != NULL; }

int web_clients(void)
{
    int n = 0;
    if (!s_mtx) return 0;
    xSemaphoreTake(s_mtx, portMAX_DELAY);
    for (int i = 0; i < MAX_WS; i++) if (s_fds[i] >= 0) n++;
    xSemaphoreGive(s_mtx);
    return n;
}

/* ---- output path: sink (non blocking) -> message buffer -> tx task -> all WebSocket clients ---- */

static void mb_send(const char *s, size_t n)
{
    if (!s_mb || !n) return;
    if (xSemaphoreTake(s_wmtx, pdMS_TO_TICKS(20)) != pdTRUE) { s_dbg_drop++; return; }
    if (xMessageBufferSend(s_mb, s, n, 0) == 0) s_dbg_drop++; else s_dbg_q++;   /* drops when full: the browser is too slow */
    xSemaphoreGive(s_wmtx);
}

void web_push(const char *json, size_t n) { if (s_srv) mb_send(json, n); }

/* assemble complete lines out of the CLI output chunks (the sink is called under the CLI output lock) */
static void web_sink(const char *d, size_t n)
{
    static char line[LINE_MAX_OUT];
    static size_t len;
    if (!s_srv) return;
    for (size_t i = 0; i < n; i++) {
        char c = d[i];
        if (c == '\r') continue;
        if (c == '\n') {
            if (len) {
                if (line[0] == '{') line[0] = ' ';              /* '{' is reserved for JSON frames */
                mb_send(line, len);
                len = 0;
            }
        } else if (len < sizeof line) line[len++] = c;
    }
}

static void ws_remove(int fd)
{
    xSemaphoreTake(s_mtx, portMAX_DELAY);
    for (int i = 0; i < MAX_WS; i++) if (s_fds[i] == fd) s_fds[i] = -1;
    xSemaphoreGive(s_mtx);
}

static bool ws_has(int fd)
{
    bool h = false;
    xSemaphoreTake(s_mtx, portMAX_DELAY);
    for (int i = 0; i < MAX_WS; i++) if (s_fds[i] == fd) h = true;
    xSemaphoreGive(s_mtx);
    return h;
}

static void ws_add(int fd)
{
    s_dbg_adds++;
    xSemaphoreTake(s_mtx, portMAX_DELAY);
    bool have = false;
    for (int i = 0; i < MAX_WS; i++) if (s_fds[i] == fd) have = true;
    for (int i = 0; i < MAX_WS && !have; i++) if (s_fds[i] < 0) { s_fds[i] = fd; have = true; }
    xSemaphoreGive(s_mtx);
}

static void tx_task(void *arg)
{
    static char msg[2048];
    for (;;) {
        size_t n = xMessageBufferReceive(s_mb, msg, sizeof msg, portMAX_DELAY);
        if (!n || !s_srv) continue;
        s_dbg_rx++;
        httpd_ws_frame_t f = { .final = true, .type = HTTPD_WS_TYPE_TEXT, .payload = (uint8_t *)msg, .len = n };
        int fds[MAX_WS];
        xSemaphoreTake(s_mtx, portMAX_DELAY);
        memcpy(fds, s_fds, sizeof fds);
        xSemaphoreGive(s_mtx);                                  /* never send while holding the lock */
        for (int i = 0; i < MAX_WS; i++) {
            if (fds[i] < 0) continue;
            esp_err_t er = httpd_ws_send_frame_async(s_srv, fds[i], &f);
            if (er == ESP_OK) s_dbg_sent++;
            else {                                              /* dead client: forget it and close */
                s_dbg_fail++; s_dbg_err = (int)er;
                ws_remove(fds[i]);
                httpd_sess_trigger_close(s_srv, fds[i]);
            }
        }
    }
}

/* ---- HTTP handlers ---- */

/* every embedded file (portal page, PWA manifest, service worker, icons) is served by this one handler; the table entry travels in user_ctx */
static esp_err_t h_asset(httpd_req_t *r)
{
    const web_asset_t *a = (const web_asset_t *)r->user_ctx;
    httpd_resp_set_type(r, a->mime);
    httpd_resp_set_hdr(r, "Cache-Control", a->cache);
    if (!strcmp(a->uri, "/sw.js")) httpd_resp_set_hdr(r, "Service-Worker-Allowed", "/");
    return httpd_resp_send(r, (const char *)a->data, (ssize_t)a->len);
}

static esp_err_t h_nocontent(httpd_req_t *r)
{
    httpd_resp_set_status(r, "204 No Content");
    return httpd_resp_send(r, NULL, 0);
}

static esp_err_t send_json(httpd_req_t *r, size_t (*fn)(char *, size_t))
{
    static char buf[2200];
    size_t n = fn(buf, sizeof buf);
    httpd_resp_set_type(r, "application/json");
    httpd_resp_set_hdr(r, "Cache-Control", "no-store");
    return httpd_resp_send(r, buf, (ssize_t)n);
}

static size_t j_state(char *b, size_t n) { return state_json(b, n, cli_vol_pct(), cli_vol_x10()); }
static esp_err_t h_state(httpd_req_t *r) { return send_json(r, j_state); }
static esp_err_t h_stats(httpd_req_t *r) { return send_json(r, stats_json); }
static esp_err_t h_favs(httpd_req_t *r) { return send_json(r, cli_favs_json); }
static esp_err_t h_presets(httpd_req_t *r) { return send_json(r, state_presets_json); }
static esp_err_t h_stations(httpd_req_t *r) { return send_json(r, cli_stations_json); }

static esp_err_t h_dbg(httpd_req_t *r)
{
    char b[260];
    int n = snprintf(b, sizeof b, "{\"queued\":%u,\"dropped\":%u,\"txRecv\":%u,\"sent\":%u,\"failed\":%u,\"lastErr\":%d,\"adds\":%u,\"gets\":%u,\"fds\":[",
                     (unsigned)s_dbg_q, (unsigned)s_dbg_drop, (unsigned)s_dbg_rx, (unsigned)s_dbg_sent, (unsigned)s_dbg_fail,
                     s_dbg_err, (unsigned)s_dbg_adds, (unsigned)s_dbg_get);
    xSemaphoreTake(s_mtx, portMAX_DELAY);
    for (int i = 0; i < MAX_WS; i++) n += snprintf(b + n, sizeof b - n, "%s%d", i ? "," : "", s_fds[i]);
    xSemaphoreGive(s_mtx);
    n += snprintf(b + n, sizeof b - n, "]}");
    httpd_resp_set_type(r, "application/json");
    return httpd_resp_send(r, b, n);
}

static esp_err_t h_cmd(httpd_req_t *r)
{
    char buf[200];
    if (r->content_len == 0 || r->content_len >= sizeof buf) { httpd_resp_send_err(r, HTTPD_400_BAD_REQUEST, "bad length"); return ESP_OK; }
    int n = httpd_req_recv(r, buf, (size_t)r->content_len);
    if (n <= 0) return ESP_FAIL;
    buf[n] = 0;
    bool ok = cli_submit(buf);
    httpd_resp_set_type(r, "text/plain");
    return httpd_resp_send(r, ok ? "queued" : "busy", HTTPD_RESP_USE_STRLEN);
}

static esp_err_t h_ws(httpd_req_t *r)
{
    int fd = httpd_req_to_sockfd(r);
    if (r->method == HTTP_GET) s_dbg_get++;
    if (!ws_has(fd)) { ws_add(fd); net_notify_ws_client(); }   /* register on handshake OR on the first frame */
    if (r->method == HTTP_GET) return ESP_OK;                  /* handshake done */
    httpd_ws_frame_t f = {0};
    f.type = HTTPD_WS_TYPE_TEXT;
    esp_err_t e = httpd_ws_recv_frame(r, &f, 0);
    if (e != ESP_OK) return e;
    if (f.len == 0) return ESP_OK;
    if (f.len >= 198) {                     /* longer than any command: swallow it */
        char *junk = malloc(f.len + 1);
        if (junk) { f.payload = (uint8_t *)junk; httpd_ws_recv_frame(r, &f, f.len); free(junk); }
        return ESP_OK;
    }
    char buf[200];
    f.payload = (uint8_t *)buf;
    e = httpd_ws_recv_frame(r, &f, f.len);
    if (e != ESP_OK) return e;
    buf[f.len] = 0;
    if (f.type == HTTPD_WS_TYPE_TEXT) cli_submit(buf);
    else if (f.type == HTTPD_WS_TYPE_CLOSE) ws_remove(httpd_req_to_sockfd(r));
    return ESP_OK;
}

static void on_close(httpd_handle_t hd, int fd)
{
    ws_remove(fd);
    close(fd);
}

void web_start(void)
{
    if (s_srv) return;
    if (!s_mtx) {
        s_mtx = xSemaphoreCreateMutex();
        s_wmtx = xSemaphoreCreateMutex();
        s_mb = xMessageBufferCreate(8192);
    }
    for (int i = 0; i < MAX_WS; i++) s_fds[i] = -1;
    if (!s_tx_task) xTaskCreate(tx_task, "slink_ws", 4096, NULL, 4, &s_tx_task);

    httpd_config_t c = HTTPD_DEFAULT_CONFIG();
    c.max_open_sockets = 6;
    c.lru_purge_enable = true;
    c.stack_size = 6144;
    c.max_uri_handlers = 24;
    c.close_fn = on_close;
    c.send_wait_timeout = 3;
    c.recv_wait_timeout = 5;
    if (httpd_start(&s_srv, &c) != ESP_OK) { s_srv = NULL; return; }

    static const httpd_uri_t uris[] = {
        { .uri = "/ws",           .method = HTTP_GET,  .handler = h_ws, .is_websocket = true, .handle_ws_control_frames = false },
        { .uri = "/api/state",    .method = HTTP_GET,  .handler = h_state },
        { .uri = "/api/presets",  .method = HTTP_GET,  .handler = h_presets },
        { .uri = "/api/stations", .method = HTTP_GET,  .handler = h_stations },
        { .uri = "/api/dbg",      .method = HTTP_GET,  .handler = h_dbg },
        { .uri = "/api/stats",    .method = HTTP_GET,  .handler = h_stats },
        { .uri = "/api/favs",     .method = HTTP_GET,  .handler = h_favs },
        { .uri = "/api/cmd",      .method = HTTP_POST, .handler = h_cmd },
        { .uri = "/favicon.ico",  .method = HTTP_GET,  .handler = h_nocontent },
    };
    for (size_t i = 0; i < sizeof uris / sizeof uris[0]; i++) httpd_register_uri_handler(s_srv, &uris[i]);
    for (size_t i = 0; i < web_assets_n; i++) {
        httpd_uri_t u = { .uri = web_assets[i].uri, .method = HTTP_GET, .handler = h_asset, .user_ctx = (void *)&web_assets[i] };
        httpd_register_uri_handler(s_srv, &u);
    }
    cli_sink_add(web_sink);
}

void web_stop(void)
{
    if (!s_srv) return;
    cli_sink_remove(web_sink);
    httpd_handle_t h = s_srv;
    s_srv = NULL;
    httpd_stop(h);
    xMessageBufferReset(s_mb);
}
